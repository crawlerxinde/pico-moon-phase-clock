/*
 * AXS15231B QSPI panel driver for the Waveshare RP2350-Touch-LCD-3.49.
 *
 * The initialization sequence and QSPI protocol are taken from Waveshare's
 * RP2350-Touch-LCD-3.49 demo package (MIT licensed).
 */
#include "lcd_3in49.h"

#include "qspi_pio.h"

#include <pico/stdlib.h>
#include <hardware/dma.h>
#include <hardware/gpio.h>
#include <hardware/pio.h>
#include <hardware/pwm.h>

typedef struct {
    uint8_t cmd;
    const uint8_t *data;
    size_t data_bytes;
    uint32_t delay_ms;
} lcd_init_cmd_t;

static const uint8_t cmd_bb_1[] = {0x00, 0x00, 0x00, 0x00, 0x00, 0x00, 0x5A, 0xA5};
static const uint8_t cmd_a0[] = {0x00, 0x30, 0x00, 0x02, 0x00, 0x00, 0x04, 0x3F, 0x20, 0x05, 0x3F, 0x3F, 0x00, 0x00, 0x00, 0x00, 0x00};
static const uint8_t cmd_a2[] = {0x30, 0x19, 0x60, 0x64, 0x9B, 0x22, 0x38, 0x80, 0xAC, 0x28, 0x7F, 0x7F, 0x7F, 0x20, 0xF8, 0x10, 0x02, 0xFF, 0xFF, 0xF0, 0x90, 0x01, 0x32, 0xA0, 0x91, 0xC0, 0x20, 0x7F, 0xFF, 0x00, 0x54};
static const uint8_t cmd_d0[] = {0x80, 0xAC, 0x21, 0x24, 0x08, 0x09, 0x10, 0x01, 0x80, 0x12, 0xC2, 0x00, 0x22, 0x22, 0xAA, 0x03, 0x10, 0x12, 0x40, 0x14, 0x1E, 0x51, 0x15, 0x00, 0x40, 0x10, 0x00, 0x03, 0x7D, 0x12};
static const uint8_t cmd_a3[] = {0xA0, 0x06, 0xAA, 0x00, 0x08, 0x02, 0x0A, 0x04, 0x04, 0x04, 0x04, 0x04, 0x04, 0x04, 0x04, 0x04, 0x04, 0x04, 0x04, 0x00, 0x55, 0x55};
static const uint8_t cmd_c1[] = {0x33, 0x04, 0x02, 0x02, 0x71, 0x05, 0x24, 0x55, 0x02, 0x00, 0x41, 0x00, 0x53, 0xFF, 0xFF, 0xFF, 0x4F, 0x52, 0x00, 0x4F, 0x52, 0x00, 0x45, 0x3B, 0x0B, 0x02, 0x0D, 0x00, 0xFF, 0x40};
static const uint8_t cmd_c3[] = {0x00, 0x00, 0x00, 0x50, 0x03, 0x00, 0x00, 0x00, 0x01, 0x80, 0x01};
static const uint8_t cmd_c4[] = {0x00, 0x24, 0x33, 0x80, 0x11, 0xEA, 0x64, 0x32, 0xC8, 0x64, 0xC8, 0x32, 0x90, 0x90, 0x11, 0x06, 0xDC, 0xFA, 0x00, 0x00, 0x80, 0xFE, 0x10, 0x10, 0x00, 0x0A, 0x0A, 0x44, 0x50};
static const uint8_t cmd_c5[] = {0x18, 0x00, 0x00, 0x03, 0xFE, 0x08, 0x68, 0x30, 0x10, 0x10, 0x88, 0xDE, 0x0D, 0x08, 0x0F, 0x0F, 0x01, 0x08, 0x68, 0x30, 0x10, 0x10, 0x00};
static const uint8_t cmd_c6[] = {0x05, 0x0A, 0x05, 0x0A, 0x00, 0xE0, 0x2E, 0x0B, 0x12, 0x22, 0x12, 0x22, 0x01, 0x00, 0x00, 0x3F, 0x6A, 0x18, 0xC8, 0x22};
static const uint8_t cmd_c7[] = {0x50, 0x32, 0x28, 0x00, 0xA2, 0x80, 0x8F, 0x00, 0x80, 0xFF, 0x07, 0x11, 0x9F, 0x6F, 0xFF, 0x24, 0x0C, 0x0D, 0x0E, 0x0F};
static const uint8_t cmd_c9[] = {0x33, 0x44, 0x44, 0x01};
static const uint8_t cmd_cf[] = {0x2C, 0x1E, 0x88, 0x58, 0x13, 0x18, 0x56, 0x18, 0x1E, 0x68, 0xF8, 0x00, 0x66, 0x0D, 0x22, 0xC4, 0x0C, 0x77, 0x22, 0x44, 0xAA, 0x55, 0x04, 0x04, 0x12, 0xA0, 0x08};
static const uint8_t cmd_d5[] = {0x50, 0x60, 0x8A, 0x00, 0x35, 0x04, 0x60, 0x10, 0x03, 0x03, 0x03, 0x00, 0x04, 0x02, 0x13, 0x46, 0x03, 0x03, 0x03, 0x03, 0x86, 0x00, 0x00, 0x00, 0x80, 0x52, 0x7C, 0x00, 0x00, 0x00};
static const uint8_t cmd_d6[] = {0x10, 0x32, 0x54, 0x76, 0x98, 0xBA, 0xDC, 0xFE, 0x00, 0x00, 0x01, 0x83, 0x03, 0x03, 0x33, 0x03, 0x03, 0x33, 0x3F, 0x03, 0x03, 0x03, 0x20, 0x20, 0x00, 0x24, 0x51, 0x23, 0x01, 0x00};
static const uint8_t cmd_d7[] = {0x18, 0x1A, 0x1B, 0x1F, 0x0A, 0x08, 0x0E, 0x0C, 0x00, 0x1F, 0x1D, 0x1F, 0x50, 0x60, 0x04, 0x00, 0x1F, 0x1F, 0x1F};
static const uint8_t cmd_d8[] = {0x18, 0x1A, 0x1B, 0x1F, 0x0B, 0x09, 0x0F, 0x0D, 0x01, 0x1F, 0x1D, 0x1F};
static const uint8_t cmd_d9[] = {0x0F, 0x09, 0x0B, 0x1F, 0x18, 0x19, 0x1F, 0x01, 0x1E, 0x1D, 0x1F};
static const uint8_t cmd_dd[] = {0x0E, 0x08, 0x0A, 0x1F, 0x18, 0x19, 0x1F, 0x00, 0x1E, 0x1A, 0x1F};
static const uint8_t cmd_df[] = {0x44, 0x73, 0x4B, 0x69, 0x00, 0x0A, 0x02, 0x90};
static const uint8_t cmd_e0[] = {0x35, 0x08, 0x19, 0x1C, 0x0C, 0x09, 0x13, 0x2A, 0x54, 0x21, 0x0B, 0x15, 0x13, 0x25, 0x27, 0x08, 0x00};
static const uint8_t cmd_e1[] = {0x3E, 0x08, 0x19, 0x1C, 0x0C, 0x08, 0x13, 0x2A, 0x54, 0x21, 0x0B, 0x14, 0x13, 0x26, 0x27, 0x08, 0x0F};
static const uint8_t cmd_e2[] = {0x19, 0x20, 0x0A, 0x11, 0x09, 0x06, 0x11, 0x25, 0xD4, 0x22, 0x0B, 0x13, 0x12, 0x2D, 0x32, 0x2F, 0x03};
static const uint8_t cmd_e3[] = {0x38, 0x20, 0x0A, 0x11, 0x09, 0x06, 0x11, 0x25, 0xC4, 0x21, 0x0A, 0x12, 0x11, 0x2C, 0x32, 0x2F, 0x27};
static const uint8_t cmd_e4[] = {0x19, 0x20, 0x0D, 0x14, 0x0D, 0x08, 0x12, 0x2A, 0xD4, 0x26, 0x0E, 0x15, 0x13, 0x34, 0x39, 0x2F, 0x03};
static const uint8_t cmd_e5[] = {0x38, 0x20, 0x0D, 0x13, 0x0D, 0x07, 0x12, 0x29, 0xC4, 0x25, 0x0D, 0x15, 0x12, 0x33, 0x39, 0x2F, 0x27};
static const uint8_t cmd_a4_1[] = {0x85, 0x85, 0x95, 0x82, 0xAF, 0xAA, 0xAA, 0x80, 0x10, 0x30, 0x40, 0x40, 0x20, 0xFF, 0x60, 0x30};
static const uint8_t cmd_a4_2[] = {0x85, 0x85, 0x95, 0x85};
static const uint8_t cmd_bb_2[] = {0x00, 0x00, 0x00, 0x00, 0x00, 0x00, 0x00, 0x00};
static const uint8_t cmd_madctl[] = {0x60}; /* MX | MV: landscape 640x172 */
static const uint8_t cmd_colmod[] = {0x55}; /* RGB565 */

static const lcd_init_cmd_t lcd_init_cmds[] = {
    {0xBB, cmd_bb_1, sizeof(cmd_bb_1), 0},
    {0xA0, cmd_a0, sizeof(cmd_a0), 0},
    {0xA2, cmd_a2, sizeof(cmd_a2), 0},
    {0xD0, cmd_d0, sizeof(cmd_d0), 0},
    {0xA3, cmd_a3, sizeof(cmd_a3), 0},
    {0xC1, cmd_c1, sizeof(cmd_c1), 0},
    {0xC3, cmd_c3, sizeof(cmd_c3), 0},
    {0xC4, cmd_c4, sizeof(cmd_c4), 0},
    {0xC5, cmd_c5, sizeof(cmd_c5), 0},
    {0xC6, cmd_c6, sizeof(cmd_c6), 0},
    {0xC7, cmd_c7, sizeof(cmd_c7), 0},
    {0xC9, cmd_c9, sizeof(cmd_c9), 0},
    {0xCF, cmd_cf, sizeof(cmd_cf), 0},
    {0xD5, cmd_d5, sizeof(cmd_d5), 0},
    {0xD6, cmd_d6, sizeof(cmd_d6), 0},
    {0xD7, cmd_d7, sizeof(cmd_d7), 0},
    {0xD8, cmd_d8, sizeof(cmd_d8), 0},
    {0xD9, cmd_d9, sizeof(cmd_d9), 0},
    {0xDD, cmd_dd, sizeof(cmd_dd), 0},
    {0xDF, cmd_df, sizeof(cmd_df), 0},
    {0xE0, cmd_e0, sizeof(cmd_e0), 0},
    {0xE1, cmd_e1, sizeof(cmd_e1), 0},
    {0xE2, cmd_e2, sizeof(cmd_e2), 0},
    {0xE3, cmd_e3, sizeof(cmd_e3), 0},
    {0xE4, cmd_e4, sizeof(cmd_e4), 0},
    {0xE5, cmd_e5, sizeof(cmd_e5), 0},
    {0xA4, cmd_a4_1, sizeof(cmd_a4_1), 0},
    {0xA4, cmd_a4_2, sizeof(cmd_a4_2), 0},
    {0xBB, cmd_bb_2, sizeof(cmd_bb_2), 0},
    {0x36, cmd_madctl, sizeof(cmd_madctl), 0},
    {0x3A, cmd_colmod, sizeof(cmd_colmod), 0},
    {0x11, NULL, 0, 120},
    {0x29, NULL, 0, 20},
};

static int      dma_tx = -1;
static dma_channel_config dma_cfg;
static uint      backlight_slice = 0;

static void send_cmd(const lcd_init_cmd_t *cmd)
{
    QSPI_Select(qspi);
    QSPI_REGISTER_Write(qspi, cmd->cmd);
    for (size_t i = 0; i < cmd->data_bytes; i++) {
        QSPI_DATA_Write(qspi, cmd->data[i]);
    }
    QSPI_Deselect(qspi);
    if (cmd->delay_ms) {
        sleep_ms(cmd->delay_ms);
    }
}

static void backlight_init(void)
{
    gpio_set_function(LCD_BL_PIN, GPIO_FUNC_PWM);
    backlight_slice = pwm_gpio_to_slice_num(LCD_BL_PIN);
    pwm_set_wrap(backlight_slice, 100);
    pwm_set_clkdiv(backlight_slice, 50.0f);
    pwm_set_chan_level(backlight_slice, pwm_gpio_to_channel(LCD_BL_PIN), 100);
    pwm_set_enabled(backlight_slice, true);
}

void LCD_SetBacklight(uint8_t percent)
{
    if (percent > 100) percent = 100;
    /* The backlight driver on this board is active low. */
    pwm_set_chan_level(backlight_slice, pwm_gpio_to_channel(LCD_BL_PIN), 100 - percent);
}

void LCD_SetRotation(uint8_t madctl)
{
    lcd_init_cmd_t cmd = {0x36, &madctl, 1, 0};
    send_cmd(&cmd);
}

void LCD_Init(void)
{
    QSPI_GPIO_Init(qspi);
    QSPI_PIO_Init(qspi);
    QSPI_4Wrie_Mode(&qspi);

    backlight_init();
    LCD_SetBacklight(0);

    /* Hardware reset */
    gpio_put(qspi.pin_rst, 1);
    sleep_ms(200);
    gpio_put(qspi.pin_rst, 0);
    sleep_ms(200);
    gpio_put(qspi.pin_rst, 1);
    sleep_ms(200);

    for (size_t i = 0; i < sizeof(lcd_init_cmds) / sizeof(lcd_init_cmds[0]); i++) {
        send_cmd(&lcd_init_cmds[i]);
    }

    dma_tx = dma_claim_unused_channel(true);
    dma_cfg = dma_channel_get_default_config(dma_tx);
    channel_config_set_transfer_data_size(&dma_cfg, DMA_SIZE_8);
    channel_config_set_read_increment(&dma_cfg, true);
    channel_config_set_write_increment(&dma_cfg, false);

    LCD_SetBacklight(0);
}

static void set_address(uint8_t cmd, uint16_t start, uint16_t end)
{
    QSPI_Select(qspi);
    QSPI_REGISTER_Write(qspi, cmd);
    QSPI_DATA_Write(qspi, start >> 8);
    QSPI_DATA_Write(qspi, start & 0xFF);
    QSPI_DATA_Write(qspi, end >> 8);
    QSPI_DATA_Write(qspi, end & 0xFF);
    QSPI_Deselect(qspi);
}

void LCD_SetWindow(uint16_t x0, uint16_t y0, uint16_t x1, uint16_t y1)
{
    set_address(0x2A, x0, x1);
    set_address(0x2B, y0, y1);
}

void LCD_WritePixels(uint16_t *pixels, size_t count)
{
    if (!pixels || !count || dma_tx < 0) return;

    QSPI_Select(qspi);
    QSPI_Pixel_Write(qspi, 0x2C);

    channel_config_set_dreq(&dma_cfg, pio_get_dreq(qspi.pio, qspi.sm, true));
    dma_channel_configure(dma_tx,
                          &dma_cfg,
                          &qspi.pio->txf[qspi.sm],
                          (const uint8_t *)pixels,
                          count * 2,
                          true);

    while (dma_channel_is_busy(dma_tx)) {
        tight_loop_contents();
    }
    while (!pio_sm_is_tx_fifo_empty(qspi.pio, qspi.sm)) {
        tight_loop_contents();
    }
    busy_wait_us_32(20);
    QSPI_Deselect(qspi);
}
